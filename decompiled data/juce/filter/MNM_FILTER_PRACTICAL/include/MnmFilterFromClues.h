#pragma once
#include <algorithm>
#include <cmath>
#include <cstdint>
#include <limits>
#include "MnmFilterEvidenceTables.h"

// Practical native filter assembled from the consolidated clue ledger.
//
// STATUS: APPROXIMATE / USABLE, NOT BIT-EXACT.
// Exact material used here: raw cutoff table words, 24-bit structural literals,
// block size 16, parameter names/range, manual octave/keytracking statements.
// Approximate material is isolated in approximateEnvelope(),
// approximateQ(), and approximateUiToTableIndex().
namespace mmnova_practical {

constexpr double kDspSampleRate = 44100.0;
constexpr double kHwA = -710467.0 / 8388608.0; // $F528BD, exact signed word
constexpr double kHwB =  4869616.0 / 8388608.0; // $4A4DF0, exact signed word

static_assert(kHwA < -0.08469 && kHwA > -0.08470, "F528BD conversion");
static_assert(kHwB >  0.58050 && kHwB <  0.58051, "4A4DF0 conversion");

enum class Mode : std::uint8_t { LowPass, HighPass, BandPass, SeriesLowPass };

struct Params
{
    int base = 0;
    int width = 127;
    int hpq = 0;
    int lpq = 0;
    int atk = 0;
    int dec = 64;
    int bofs = 64;
    int wofs = 64;
    Mode mode = Mode::SeriesLowPass;
};

struct DebugState
{
    double envelope = 0.0;
    double effectiveBase = 0.0;
    double effectiveWidth = 0.0;
    int hpTableIndex = 0;
    int lpTableIndex = 0;
    double hpCoefficient = 0.0;
    double lpCoefficient = 0.0;
    double hpQ = 0.0;
    double lpQ = 0.0;
};

inline int clamp7(int x) noexcept { return std::clamp(x, 0, 127); }
inline double wordToQ23(std::uint32_t x) noexcept
{
    return static_cast<double>(x & 0x7FFFFFu) / 8388608.0;
}

// The table is monotone and was generated by the firmware. This returns the
// nearest exact table word for a target coefficient. The mapping from UI
// steps/note to table index is intentionally not called exact.
inline int approximateUiToTableIndex(double targetCoefficient) noexcept
{
    targetCoefficient = std::clamp(targetCoefficient, 0.0, 1.0);
    int lo = 0;
    int hi = kCutoffP143546Count - 1;
    while (lo < hi)
    {
        const int mid = lo + (hi - lo) / 2;
        if (wordToQ23(kCutoffP143546[mid]) < targetCoefficient)
            lo = mid + 1;
        else
            hi = mid;
    }
    if (lo > 0)
    {
        const double a = wordToQ23(kCutoffP143546[lo - 1]);
        const double b = wordToQ23(kCutoffP143546[lo]);
        if (std::abs(a - targetCoefficient) < std::abs(b - targetCoefficient))
            --lo;
    }
    return lo;
}

inline double exactCutoffWordAt(int index) noexcept
{
    index = std::clamp(index, 0, kCutoffP143546Count - 1);
    return wordToQ23(kCutoffP143546[index]);
}

// Manual/community law: the filter tracks the note and eight steps are one
// octave. The firmware's internal table index formula is not substituted here.
inline double approximateCutoffCoefficient(double noteHz, double steps,
                                           int& tableIndex) noexcept
{
    noteHz = std::clamp(noteHz, 1.0, 20000.0);
    const double hz = noteHz * 0.25 * std::exp2(steps / 8.0);
    const double wanted = 2.0 * std::sin(3.14159265358979323846
                                         * std::clamp(hz, 0.0, kDspSampleRate * 0.49)
                                         / kDspSampleRate);
    tableIndex = approximateUiToTableIndex(wanted);
    return exactCutoffWordAt(tableIndex);
}

// The slope/shape is not recovered from the Q interpolation tables. Keep the
// old clue-derived curve in one replaceable function and label it approximate.
inline double approximateQ(int knob7) noexcept
{
    const double n = clamp7(knob7) / 127.0;
    return std::clamp(2.0 + kHwA - n * 1.88, 0.05, 2.0);
}

// The listing proves a trigger/reset and block processing, but not this exact
// UI-rate law. This simple AD law is deliberately replaceable.
inline double approximateEnvelope(double& value, bool& attacking,
                                  int atk7, int dec7) noexcept
{
    if (attacking)
    {
        value += 1.0 / (1.0 + clamp7(atk7) * 12.0);
        if (value >= 1.0) { value = 1.0; attacking = false; }
    }
    else
    {
        value -= 1.0 / (1.0 + clamp7(dec7) * 16.0);
        if (value < 0.0) value = 0.0;
    }
    return value;
}

class MnmFilterFromClues
{
public:
    void prepare(double sampleRate) noexcept
    {
        m_sampleRate = sampleRate > 1.0 ? sampleRate : kDspSampleRate;
        reset();
    }

    void reset() noexcept
    {
        m_env = 0.0;
        m_attacking = true;
        m_hpLow = m_hpBand = 0.0;
        m_lpLow = m_lpBand = 0.0;
        m_debug = {};
    }

    void trigger() noexcept
    {
        m_env = 0.0;
        m_attacking = true;
    }

    void setParams(Params p) noexcept { m_params = p; }
    void setNoteHz(double hz) noexcept { m_noteHz = hz; }
    const DebugState& debug() const noexcept { return m_debug; }

    // Native hardware quantum. UI changes are evaluated once, then 16 samples
    // run with the same coefficients, matching the known block cadence.
    void processBlock16(float* samples) noexcept
    {
        const double env = approximateEnvelope(m_env, m_attacking,
                                               m_params.atk, m_params.dec);
        const double bofs = (clamp7(m_params.bofs) - 64) * 2.0;
        const double wofs = (clamp7(m_params.wofs) - 64) * 2.0;
        const double effectiveBase = std::clamp(clamp7(m_params.base) + env * bofs,
                                                0.0, 127.0);
        const double effectiveWidth = std::clamp(clamp7(m_params.width) + env * wofs,
                                                 0.0, 127.0);
        const double hp = approximateCutoffCoefficient(m_noteHz, effectiveBase,
                                                       m_debug.hpTableIndex);
        const double lp = approximateCutoffCoefficient(m_noteHz,
                                                       effectiveBase + effectiveWidth,
                                                       m_debug.lpTableIndex);
        m_hpF = hp;
        m_lpF = lp;
        m_hpQ = approximateQ(m_params.hpq);
        m_lpQ = approximateQ(m_params.lpq);
        m_debug.envelope = env;
        m_debug.effectiveBase = effectiveBase;
        m_debug.effectiveWidth = effectiveWidth;
        m_debug.hpCoefficient = hp;
        m_debug.lpCoefficient = lp;
        m_debug.hpQ = m_hpQ;
        m_debug.lpQ = m_lpQ;

        for (int i = 0; i < 16; ++i)
            samples[i] = static_cast<float>(processOne(samples[i]));
    }

    void processBlock(float* samples, int count) noexcept
    {
        while (count >= 16)
        {
            processBlock16(samples);
            samples += 16;
            count -= 16;
        }
        // Host blocks need not be multiples of 16. The original DSP quantum
        // is still used for coefficient updates; the tail uses last values.
        for (int i = 0; i < count; ++i)
            samples[i] = static_cast<float>(processOne(samples[i]));
    }

private:
    double processOne(float input) noexcept
    {
        const double x = std::clamp(static_cast<double>(input), -1.0, 1.0);
        const double hpHigh = x - m_hpLow - m_hpQ * m_hpBand;
        m_hpBand += m_hpF * hpHigh;
        m_hpLow += m_hpF * m_hpBand;

        const double lpInput = (m_params.mode == Mode::SeriesLowPass) ? hpHigh : x;
        const double lpHigh = lpInput - m_lpLow - m_lpQ * m_lpBand;
        m_lpBand += m_lpF * lpHigh;
        m_lpLow += m_lpF * m_lpBand;

        double y = m_lpLow;
        switch (m_params.mode)
        {
            case Mode::LowPass:       y = m_lpLow; break;
            case Mode::HighPass:      y = hpHigh; break;
            case Mode::BandPass:      y = m_lpBand; break;
            case Mode::SeriesLowPass: y = m_lpLow; break;
        }
        return std::clamp(y, -1.0, 1.0);
    }

    double m_sampleRate = kDspSampleRate;
    double m_noteHz = 261.625565;
    Params m_params{};
    double m_env = 0.0;
    bool m_attacking = true;
    double m_hpF = 0.0, m_lpF = 0.0;
    double m_hpQ = 1.0, m_lpQ = 1.0;
    double m_hpLow = 0.0, m_hpBand = 0.0;
    double m_lpLow = 0.0, m_lpBand = 0.0;
    DebugState m_debug{};
};

} // namespace mmnova_practical
